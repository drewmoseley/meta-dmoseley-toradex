## conf/layer.conf
```bitbake
# We have a conf and classes directory, add to BBPATH
BBPATH .= ":${LAYERDIR}"

# We have recipes-* directories, add to BBFILES
BBFILES += "${LAYERDIR}/recipes-*/*/*.bb \
            ${LAYERDIR}/recipes-*/*/*.bbappend"

#
# The dynamic-layers directory hosts layer specific modifications.
#
BBFILES_DYNAMIC += " \
    chromium-browser-layer:${LAYERDIR}/dynamic-layers/chromium-browser-layer/*/*/*.bbappend \
    meta-toradex-torizon:${LAYERDIR}/dynamic-layers/meta-toradex-torizon/*/*/*.bbappend \
    fsl-bsp-release:${LAYERDIR}/dynamic-layers/meta-imx-bsp/*/*/*.bbappend \
    toradex-demos:${LAYERDIR}/dynamic-layers/toradex-demos/*/*/*.bbappend \
"

BBFILE_COLLECTIONS += "meta-dmoseley-toradex"
BBFILE_PATTERN_meta-dmoseley-toradex = "^${LAYERDIR}/"
BBFILE_PRIORITY_meta-dmoseley-toradex = "99"

LAYERDEPENDS_meta-dmoseley-toradex = "core "
LAYERSERIES_COMPAT_meta-dmoseley-toradex = "scarthgap"





#
# This stuff should really be in a bbclass or some such but we'll do
# it here for simplicity
#
NXP_PROPRIETARY_DRIVER_LOCATION = "file:///work2/dmoseley/Toradex/Wifi/archive"
# INHERIT += "toradex-wifi-nxp-proprietary-driver"
# MACHINEOVERRIDES =. "default-nxp-proprietary-driver:"
# MACHINEOVERRIDES =. "mfg-mode:"

PREFERRED_PROVIDER_virtual/wpebackend = "wpebackend-fdo"
PREFERRED_RPROVIDER_virtual/wpebackend = "wpebackend-fdo"

# Add wifi for beaglebone since we will use either a bbb wireless or a USB dongle
KERNEL_DEVICETREE:prepend:beaglebone-yocto = " am335x-boneblack-wireless.dtb am335x-pocketbeagle.dtb "
IMAGE_BOOT_FILES:append:beaglebone-yocto = " am335x-boneblack-wireless.dtb am335x-pocketbeagle.dtb "


TEZI_EXTERNAL_KERNEL_DEVICETREE_BOOT:colibri-imx6:use-mainline-bsp = "colibri-imx6_panel-res-touch-7inch_overlay.dtbo"
TEZI_EXTERNAL_KERNEL_DEVICETREE_BOOT:colibri-imx6ull:use-mainline-bsp = "colibri-imx6ull_panel-res-touch-7inch_overlay.dtbo"
TEZI_EXTERNAL_KERNEL_DEVICETREE_BOOT:colibri-imx6ull-emmc:use-mainline-bsp = "colibri-imx6ull_panel-res-touch-7inch_overlay.dtbo"
TEZI_EXTERNAL_KERNEL_DEVICETREE_BOOT:colibri-imx7-emmc:use-mainline-bsp = "colibri-imx7_panel-res-touch-7inch_overlay.dtbo"
TEZI_EXTERNAL_KERNEL_DEVICETREE_BOOT:colibri-imx8x:use-mainline-bsp = "colibri-imx8x_panel-cap-touch-7inch_overlay.dtbo"
```
